## project/bl616_usb_ncm/app/Kconfig
```kconfig
mainmenu "BL616 USB CDC-NCM validation"
source "$BL_SDK_BASE/Kconfig"

config USB_NCM_FULL_SPEED_ONLY
    bool "Force USB Full-Speed for NCM diagnostics"
    default n
    help
      Disable High-Speed negotiation to compare enumeration behavior.

config USB_NCM_ENUM_DEBUG
    bool "Log USB control transfers for NCM diagnostics"
    default n
    help
      Enable CherryUSB debug logs, including EP0 setup requests.
```

## project/bl616_usb_ncm/app/defconfig
```kconfig
CONFIG_FREERTOS =y
CONFIG_SHELL =y
CONFIG_BFLB_LOG =n
CONFIG_CHERRYUSB =y
CONFIG_CHERRYUSB_OSAL =freertos
CONFIG_CHERRYUSB_DEVICE =y
CONFIG_BSP_USB =y
CONFIG_ROMAPI =n
ifeq ($(CHIP),bl618dg)
CONFIG_RAM_FOR_AP_SIZE =0x50000
CONFIG_WRAM_FOR_AP_SIZE =0x50000
CONFIG_DUALCORE_DISABLE =y
endif
```

## project/bl618dg_pan/pan_ap/Kconfig
```kconfig
mainmenu "BL618DG PAN and coexistence"
source "$BL_SDK_BASE/Kconfig"
config PAN_HOST
    bool "Bluedroid PAN host"
    default y
config PAN_COEX
    bool "Official Wi-Fi and Bluetooth coexistence"
    depends on PAN_HOST
    default n
config PAN_WIFI_ONLY
    bool "Wi-Fi-only validation with FreeRTOS+TCP"
    depends on !PAN_HOST
    default n
config PAN_RF_DIAG
    bool "Isolated RF initialization diagnostics"
    depends on PAN_WIFI_ONLY
    default n
config PAN_COEX_COMBO
    bool "Combo RF coexistence validation"
    depends on PAN_COEX
    default n

config PAN_SPP
    bool "Standalone SPP throughput validation"
    depends on PAN_HOST && !PAN_COEX
    default n
```

## project/bl618dg_pan/pan_ap/defconfig
```kconfig
CONFIG_FREERTOS =y
CONFIG_SHELL =y
CONFIG_BFLB_LOG =n
ifeq ($(CHIP),bl618dg)
CONFIG_RAM_FOR_AP_SIZE =0x50000
CONFIG_WRAM_FOR_AP_SIZE =0x50000
endif
ifneq ($(filter y,$(CONFIG_PAN_RF_DIAG)),)
CONFIG_BLUETOOTH =y
else ifeq ($(CONFIG_PAN_WIFI_ONLY),y)
CONFIG_BLUETOOTH =n
else
CONFIG_BLUETOOTH =y
endif
CONFIG_BTBLECONTROLLER_LIB =ble1m2s1bredr1
CONFIG_BLE_HOST_DISABLE =y
CONFIG_RF =y
CONFIG_LITTLEFS =y
CONFIG_BFLB_MTD =y
CONFIG_PARTITION =y

ifneq ($(filter y,$(CONFIG_PAN_COEX) $(CONFIG_PAN_WIFI_ONLY)),)
CONFIG_WIFI6 =y
CONFIG_FHOST =y
CONFIG_MACSW_SELECT =default
ifeq ($(CONFIG_PAN_COEX),y)
CONFIG_BT_PATH =y
endif
CONFIG_MBEDTLS =y
CONFIG_POSIX =y
endif
# Official BL618DG coexistence runs the radio stacks on AP without starting NP.
ifeq ($(CHIP),bl618dg)
CONFIG_DUALCORE_DISABLE =y
endif
CONFIG_ROMAPI =n
```

## project/bl618dg_pan/pan_np/Kconfig
```kconfig
mainmenu "BL618DG PAN and coexistence"
source "$BL_SDK_BASE/Kconfig"
config PAN_HOST
    bool "Bluedroid PAN host"
    default y
config PAN_COEX
    bool "Official Wi-Fi and Bluetooth coexistence"
    depends on PAN_HOST
    default n
config PAN_WIFI_ONLY
    bool "Wi-Fi-only validation with FreeRTOS+TCP"
    depends on !PAN_HOST
    default n
config PAN_RF_DIAG
    bool "Isolated RF initialization diagnostics"
    depends on PAN_WIFI_ONLY
    default n
config PAN_SOFT_AP
    bool "Isolated SoftAP stability validation"
    depends on PAN_WIFI_ONLY && !PAN_RF_DIAG
    default n
config PAN_COEX_COMBO
    bool "Combo RF coexistence validation"
    depends on PAN_COEX
    default n
config PAN_SPP
    bool "Standalone SPP throughput validation"
    depends on PAN_HOST && !PAN_COEX
    default n

config PAN_HCI_TRACE
    bool "HCI initialization diagnostics"
    default n

config PAN_GATT_BR
    bool "GATT over BR/EDR validation"
    depends on PAN_HOST && !PAN_SPP && !PAN_COEX
    default n

config PAN_GATT_LE
    bool
    default n

config PAN_NIMBLE_COC
    bool "NimBLE LE CoC standalone validation"
    default n

config PAN_BLUEDROID_COC
    bool "Bluedroid LE CoC standalone validation"
    default n

config PAN_NIMBLE_GATT
    bool "NimBLE GATT BLE standalone validation"
    default n
```

## project/bl618dg_pan/pan_np/defconfig
```kconfig
CONFIG_FREERTOS =y
CONFIG_SHELL =y
CONFIG_BFLB_LOG =n
CONFIG_RAM_FOR_AP_SIZE =0x50000
CONFIG_WRAM_FOR_AP_SIZE =0x50000
```
