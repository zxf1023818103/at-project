## project/bl618dg_nan/app/Kconfig
```kconfig
mainmenu "BL618DG AP NAN over USB"
source "$BL_SDK_BASE/Kconfig"
config NAN_NATIVE_WHC_USB
    bool "Use Green2 original native WHC USB firmware"
    default n
config NAN_USB_DIAGNOSTICS
    bool "Measure USB/RX stages, task CPU time and TCP metadata"
    depends on NAN_NATIVE_WHC_USB
    default n
config NAN_SRAM_HOTCODE
    bool "Link the NAN packet path into internal SRAM"
    depends on !PSRAM_COPY_CODE && !PSRAM_XIP && DUALCORE_DISABLE
    default n
```

## project/bl618dg_usb_bench/app/Kconfig
```kconfig
mainmenu "BL618DG CherryUSB Bulk benchmark"
source "$BL_SDK_BASE/Kconfig"
config USB_BENCH_HOST
    bool "Start USB in host mode"
    default y
```

## project/bl618dg_usb_bench/app/defconfig
```kconfig
CONFIG_FREERTOS =y
CONFIG_SHELL =y
CONFIG_CONSOLE_UART_BAUDRATE =500000
CONFIG_BFLB_LOG =n
CONFIG_CHERRYUSB =y
CONFIG_CHERRYUSB_OSAL =freertos
CONFIG_CHERRYUSB_DEVICE =y
CONFIG_CHERRYUSB_HOST =y
CONFIG_BSP_USB =y
CONFIG_ROMAPI =n
CONFIG_RAM_FOR_AP_SIZE =0x50000
CONFIG_WRAM_FOR_AP_SIZE =0x50000
CONFIG_DUALCORE_DISABLE =y
```
